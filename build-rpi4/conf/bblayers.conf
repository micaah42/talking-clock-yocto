## build-rpi4/conf/bblayers.conf
```bitbake
# POKY_BBLAYERS_CONF_VERSION is increased each time build/conf/bblayers.conf
# changes incompatibly
POKY_BBLAYERS_CONF_VERSION = "2"

BBPATH = "${TOPDIR}"
BBFILES ?= ""

BBLAYERS ?= " \
  ${TOPDIR}/../poky/meta \
  ${TOPDIR}/../poky/meta-poky \
  ${TOPDIR}/../poky/meta-yocto-bsp \
  \
  ${TOPDIR}/../layers/meta-openembedded/meta-oe \
  ${TOPDIR}/../layers/meta-openembedded/meta-python \
  ${TOPDIR}/../layers/meta-openembedded/meta-webserver \
  ${TOPDIR}/../layers/meta-openembedded/meta-multimedia \
  \
  ${TOPDIR}/../layers/meta-qt5 \
  ${TOPDIR}/../layers/meta-raspberrypi \
  \
  ${TOPDIR}/../layers/meta-clock \
"
```

## build-rpi4/conf/local.conf
```bitbake
# Distro Stuff
# maybe move to layer conf?

INIT_MANAGER = "systemd"
DISTRO_FEATURES:append = " egl eglfs gles2 opengl kms gbm alsa pulseaudio"
DISTRO_FEATURES:remove = " x11 wayland dbus gstreamer vulkan"
DISTRO = "poky"

HDMI_CVT = "1024 600 60 3 0 0 1"
HDMI_MODE = "87"
HDMI_GROUP = "2"

DISABLE_OVERSCAN = "1"

# --- --- --- --- --- --- --- --- --- --- --- ---
# MACHINE SPECIFIC
MACHINE = "raspberrypi4-64"
IMAGE_FSTYPES = "rpi-sdimg"

# faster boot
BOOT_DELAY = "0"
BOOT_DELAY_MS = "750"

# more reliable graphics
GPU_MEM = "512"

# turbo mode
# ARM_FREQ = "1800"
# OVER_VOLTAGE = "6"

# splash screen
ENABLE_I2C = "1"
ENABLE_UART = "1"
DISABLE_SPLASH = "0"
DISABLE_RPI_BOOT_LOGO = "0"

# install licenses for all packages
LICENSE_CREATE_PACKAGE = "1"

# commercial :(
LICENSE_FLAGS_ACCEPTED = "commercial"

# --- --- --- --- --- --- --- --- --- --- --- ---

# Yocto build configuration

PACKAGE_CLASSES = "package_rpm"
USER_CLASSES = "buildstats"
PATCHRESOLVE = "noop"

BB_NUMBER_THREADS = "10"
PARALLEL_MAKE = "-j 10"

BB_DISKMON_DIRS ??= "\
  STOPTASKS,${TMPDIR},1G,100K \
  STOPTASKS,${DL_DIR},1G,100K \
  STOPTASKS,${SSTATE_DIR},1G,100K \
  STOPTASKS,/tmp,100M,100K \
  HALT,${TMPDIR},100M,1K \
  HALT,${DL_DIR},100M,1K \
  HALT,${SSTATE_DIR},100M,1K \
  HALT,/tmp,10M,1K \
"

CONF_VERSION = "2"
```
